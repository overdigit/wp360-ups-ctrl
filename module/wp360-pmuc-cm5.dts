/dts-v1/;
/plugin/;

/ {
    compatible = "brcm,bcm2712";
    fragment@0 {
        target-path = "/";
        __overlay__ {
            wp360-pmuc {
                compatible = "overdigit,wp360-pmuc";
                comm-gpios = <&rp1_gpio 24 1>, <&rp1_gpio 23 1>;
            };
        };
    };
};
